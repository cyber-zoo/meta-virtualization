## conf/distro/include/meta-virt-host.conf
```bitbake
# Base virtualization host configuration fragment
#
# Common DISTRO_FEATURES for any virtualization work: containers, Xen,
# k3s, or custom/mixed configurations.
#
# Use standalone for custom builds:
#
#   require conf/distro/include/meta-virt-host.conf
#   MACHINE = "qemux86-64"
#
# Or let a specific profile (container-host-*, xen-host-*) inherit it.

DISTRO_FEATURES:append = " virtualization systemd seccomp vmsep vcontainer"

# Container runtime provider — the unified runc recipe provides both
# runc-docker and runc-opencontainers via RPROVIDES
PREFERRED_PROVIDER_virtual/runc ?= "runc"

# Multiconfig for cross-arch builds:
#   vruntime-*   : minimal VM rootfs (vdkr/vpdmn blobs)
#   container-*  : OCI container images (multi-arch)
BBMULTICONFIG ?= "vruntime-aarch64 vruntime-x86-64 container-aarch64 container-x86-64"
```

## conf/distro/vcontainer.conf
```bitbake
# SPDX-FileCopyrightText: Copyright (C) 2025 Bruce Ashfield
#
# SPDX-License-Identifier: MIT
#
# VContainer - OCI container image builder distro
#
# Shares the same stripped DISTRO_FEATURES as vruntime but without BBMASK,
# so OCI tooling (umoci, jq, skopeo) and the full package set are available.
#
# Used by container-aarch64 / container-x86-64 multiconfigs to build
# single-arch OCI images that are then combined into multi-arch indexes.

require conf/distro/include/vruntime-base.inc

# No BBMASK -- OCI image building needs umoci, jq, and full package set.

DISTRO = "vcontainer"
DISTRO_NAME = "VContainer OCI Builder"
DISTRO_VERSION = "1.0"

# IMAGE_FSTYPES is NOT set here -- the 'oci' type requires image-oci.bbclass
# which only container image recipes inherit. Setting it distro-wide would
# break non-container images (e.g., core-image-*) parsed in this distro.
# Container recipes like container-base.bb set their own IMAGE_FSTYPES.
```
